## hello_serial_input_interrupt/build/Kconfig/arch/Kconfig
```kconfig
# Load arch Kconfig descriptions.
osource "/Users/rgupta/zephyrproject/zephyr/arch/x86/Kconfig"
osource "/Users/rgupta/zephyrproject/zephyr/arch/xtensa/Kconfig"
osource "/Users/rgupta/zephyrproject/zephyr/arch/sparc/Kconfig"
osource "/Users/rgupta/zephyrproject/zephyr/arch/riscv/Kconfig"
osource "/Users/rgupta/zephyrproject/zephyr/arch/posix/Kconfig"
osource "/Users/rgupta/zephyrproject/zephyr/arch/nios2/Kconfig"
osource "/Users/rgupta/zephyrproject/zephyr/arch/mips/Kconfig"
osource "/Users/rgupta/zephyrproject/zephyr/arch/arm64/Kconfig"
osource "/Users/rgupta/zephyrproject/zephyr/arch/arm/Kconfig"
osource "/Users/rgupta/zephyrproject/zephyr/arch/arc/Kconfig"
```

## hello_serial_input_led/build/Kconfig/soc/Kconfig
```kconfig
# Load Zephyr SoC Kconfig descriptions.
osource "/Users/rgupta/zephyrproject/zephyr/soc/xlnx/zynqmp/Kconfig"
osource "/Users/rgupta/zephyrproject/zephyr/soc/xlnx/zynq7000/Kconfig"
osource "/Users/rgupta/zephyrproject/zephyr/soc/xen/Kconfig"
osource "/Users/rgupta/zephyrproject/zephyr/soc/ti/simplelink/Kconfig"
osource "/Users/rgupta/zephyrproject/zephyr/soc/ti/lm3s6965/Kconfig"
osource "/Users/rgupta/zephyrproject/zephyr/soc/ti/k3/Kconfig"
osource "/Users/rgupta/zephyrproject/zephyr/soc/telink/tlsr/Kconfig"
osource "/Users/rgupta/zephyrproject/zephyr/soc/starfive/jh71xx/Kconfig"
osource "/Users/rgupta/zephyrproject/zephyr/soc/st/stm32/Kconfig"
osource "/Users/rgupta/zephyrproject/zephyr/soc/snps/qemu_arc/Kconfig"
osource "/Users/rgupta/zephyrproject/zephyr/soc/snps/nsim/arc_v/Kconfig"
osource "/Users/rgupta/zephyrproject/zephyr/soc/snps/nsim/arc_classic/Kconfig"
osource "/Users/rgupta/zephyrproject/zephyr/soc/snps/hsdk4xd/Kconfig"
osource "/Users/rgupta/zephyrproject/zephyr/soc/snps/hsdk/Kconfig"
osource "/Users/rgupta/zephyrproject/zephyr/soc/snps/emsk/Kconfig"
osource "/Users/rgupta/zephyrproject/zephyr/soc/snps/emsdp/Kconfig"
osource "/Users/rgupta/zephyrproject/zephyr/soc/snps/arc_iot/Kconfig"
osource "/Users/rgupta/zephyrproject/zephyr/soc/silabs/Kconfig"
osource "/Users/rgupta/zephyrproject/zephyr/soc/sifive/sifive_freedom/Kconfig"
osource "/Users/rgupta/zephyrproject/zephyr/soc/rockchip/Kconfig"
osource "/Users/rgupta/zephyrproject/zephyr/soc/renode/riscv_virtual/Kconfig"
osource "/Users/rgupta/zephyrproject/zephyr/soc/renesas/smartbond/Kconfig"
osource "/Users/rgupta/zephyrproject/zephyr/soc/renesas/rzt2m/Kconfig"
osource "/Users/rgupta/zephyrproject/zephyr/soc/renesas/rcar/Kconfig"
osource "/Users/rgupta/zephyrproject/zephyr/soc/renesas/ra/Kconfig"
osource "/Users/rgupta/zephyrproject/zephyr/soc/raspberrypi/Kconfig"
osource "/Users/rgupta/zephyrproject/zephyr/soc/quicklogic/eos_s3/Kconfig"
osource "/Users/rgupta/zephyrproject/zephyr/soc/qemu/virt_riscv/Kconfig"
osource "/Users/rgupta/zephyrproject/zephyr/soc/qemu/malta/Kconfig"
osource "/Users/rgupta/zephyrproject/zephyr/soc/openisa/rv32m1/Kconfig"
osource "/Users/rgupta/zephyrproject/zephyr/soc/nxp/s32/Kconfig"
osource "/Users/rgupta/zephyrproject/zephyr/soc/nxp/rw/Kconfig"
osource "/Users/rgupta/zephyrproject/zephyr/soc/nxp/mcx/Kconfig"
osource "/Users/rgupta/zephyrproject/zephyr/soc/nxp/lpc/Kconfig"
osource "/Users/rgupta/zephyrproject/zephyr/soc/nxp/layerscape/Kconfig"
osource "/Users/rgupta/zephyrproject/zephyr/soc/nxp/kinetis/Kconfig"
osource "/Users/rgupta/zephyrproject/zephyr/soc/nxp/imxrt/Kconfig"
osource "/Users/rgupta/zephyrproject/zephyr/soc/nxp/imx/Kconfig"
osource "/Users/rgupta/zephyrproject/zephyr/soc/nuvoton/numicro/Kconfig"
osource "/Users/rgupta/zephyrproject/zephyr/soc/nuvoton/numaker/Kconfig"
osource "/Users/rgupta/zephyrproject/zephyr/soc/nuvoton/npcx/Kconfig"
osource "/Users/rgupta/zephyrproject/zephyr/soc/nordic/Kconfig"
osource "/Users/rgupta/zephyrproject/zephyr/soc/neorv32/Kconfig"
osource "/Users/rgupta/zephyrproject/zephyr/soc/native/inf_clock/Kconfig"
osource "/Users/rgupta/zephyrproject/zephyr/soc/microchip/miv/Kconfig"
osource "/Users/rgupta/zephyrproject/zephyr/soc/microchip/mec/Kconfig"
osource "/Users/rgupta/zephyrproject/zephyr/soc/mediatek/mtk_adsp/Kconfig"
osource "/Users/rgupta/zephyrproject/zephyr/soc/lowrisc/opentitan/Kconfig"
osource "/Users/rgupta/zephyrproject/zephyr/soc/litex/litex_vexriscv/Kconfig"
osource "/Users/rgupta/zephyrproject/zephyr/soc/ite/ec/Kconfig"
osource "/Users/rgupta/zephyrproject/zephyr/soc/intel/raptor_lake/Kconfig"
osource "/Users/rgupta/zephyrproject/zephyr/soc/intel/lakemont/Kconfig"
osource "/Users/rgupta/zephyrproject/zephyr/soc/intel/intel_socfpga_std/Kconfig"
osource "/Users/rgupta/zephyrproject/zephyr/soc/intel/intel_socfpga/Kconfig"
osource "/Users/rgupta/zephyrproject/zephyr/soc/intel/intel_niosv/Kconfig"
osource "/Users/rgupta/zephyrproject/zephyr/soc/intel/intel_ish/Kconfig"
osource "/Users/rgupta/zephyrproject/zephyr/soc/intel/intel_adsp/Kconfig"
osource "/Users/rgupta/zephyrproject/zephyr/soc/intel/elkhart_lake/Kconfig"
osource "/Users/rgupta/zephyrproject/zephyr/soc/intel/atom/Kconfig"
osource "/Users/rgupta/zephyrproject/zephyr/soc/intel/apollo_lake/Kconfig"
osource "/Users/rgupta/zephyrproject/zephyr/soc/intel/alder_lake/Kconfig"
osource "/Users/rgupta/zephyrproject/zephyr/soc/infineon/cat3/Kconfig"
osource "/Users/rgupta/zephyrproject/zephyr/soc/infineon/cat1b/Kconfig"
osource "/Users/rgupta/zephyrproject/zephyr/soc/infineon/cat1a/Kconfig"
osource "/Users/rgupta/zephyrproject/zephyr/soc/gd/gd32/Kconfig"
osource "/Users/rgupta/zephyrproject/zephyr/soc/gaisler/leon3/Kconfig"
osource "/Users/rgupta/zephyrproject/zephyr/soc/gaisler/gr716a/Kconfig"
osource "/Users/rgupta/zephyrproject/zephyr/soc/espressif/Kconfig"
osource "/Users/rgupta/zephyrproject/zephyr/soc/ene/kb1200/Kconfig"
osource "/Users/rgupta/zephyrproject/zephyr/soc/efinix/sapphire/Kconfig"
osource "/Users/rgupta/zephyrproject/zephyr/soc/cdns/xtensa_sample_controller/Kconfig"
osource "/Users/rgupta/zephyrproject/zephyr/soc/cdns/dc233c/Kconfig"
osource "/Users/rgupta/zephyrproject/zephyr/soc/brcm/bcmvk/Kconfig"
osource "/Users/rgupta/zephyrproject/zephyr/soc/brcm/bcm2712/Kconfig"
osource "/Users/rgupta/zephyrproject/zephyr/soc/brcm/bcm2711/Kconfig"
osource "/Users/rgupta/zephyrproject/zephyr/soc/atmel/sam0/Kconfig"
osource "/Users/rgupta/zephyrproject/zephyr/soc/atmel/sam/Kconfig"
osource "/Users/rgupta/zephyrproject/zephyr/soc/aspeed/Kconfig"
osource "/Users/rgupta/zephyrproject/zephyr/soc/arm/Kconfig"
osource "/Users/rgupta/zephyrproject/zephyr/soc/arm/beetle/Kconfig"
osource "/Users/rgupta/zephyrproject/zephyr/soc/andestech/Kconfig"
osource "/Users/rgupta/zephyrproject/zephyr/soc/ambiq/Kconfig"
osource "/Users/rgupta/zephyrproject/zephyr/soc/altr/zephyr_nios2f/Kconfig"
osource "/Users/rgupta/zephyrproject/zephyr/soc/altr/qemu_nios2/Kconfig"
osource "/Users/rgupta/zephyrproject/zephyr/soc/adi/max32/Kconfig"
```
